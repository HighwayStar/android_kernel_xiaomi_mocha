/dts-v1/;

#include "tegra124-tn8.dtsi"
#include "tegra124-platforms/tegra124-tn8-dfll.dtsi"
#include "tegra124-platforms/tegra124-tn8-emc-p1761-1270-a00.dtsi"
#include "tegra124-platforms/tegra124-tn8-pmic-e1936-1000-a00.dtsi"
#include "tegra124-platforms/tegra124-tn8-fixed-e1936-1000-a00.dtsi"
#include "tegra124-platforms/tegra124-tn8-sensor-p1761-1470-a00.dtsi"
#include "tegra124-platforms/tegra124-tn8-pinmux-p1761-1470-a00.dtsi"
#include "tegra124-platforms/tegra124-tn8-gpio-p1761-1470-a00.dtsi"
#include "tegra124-platforms/tegra124-tn8-keys-e1780-1100-a02.dtsi"
#include "tegra124-platforms/tegra124-tn8-powermon-p1761-a00.dtsi"

/ {
	model = "NVIDIA Tegra124 TN8 FFD";
	compatible = "nvidia,tn8", "nvidia,tegra124";
	nvidia,dtsfilename = __FILE__;
	nvidia,boardids = "1761:1270:0";
	#address-cells = <2>;
	#size-cells = <2>;

	chosen {
		bootargs = "tegraid=40.0.0.00.00 vmalloc=256M video=tegrafb console=ttyS0,115200n8 earlyprintk";
		linux,initrd-start = <0x85000000>;
		linux,initrd-end = <0x851bc400>;
	};

	udc@7d000000 {
		nvidia,id-detection-type = <1>;
		nvidia,enable-pmu-vbus-detection;
		nvidia,enable-aca-rid-detection;
		extcon-cables = <&extcon_cable_xlate 0 &extcon_cable_xlate 2 &extcon_cable_xlate 5>;
		extcon-cable-names = "vbus", "aca-rb", "aca-rc";
		#extcon-cells = <1>;
		status = "okay";
	};

	otg@7d000000 {
		nvidia,enable-pmu-vbus-detection;
		nvidia,id-detection-type = <1>;
		nvidia,enable-y-cable-detection;
		nvidia,enable-aca-rid-detection;
		extcon-cables = <&extcon_cable_xlate 0 &extcon_cable_xlate 1 &extcon_cable_xlate 2 &extcon_cable_xlate 3 &extcon_cable_xlate 4 &extcon_cable_xlate 5>;
		extcon-cable-names = "vbus", "id", "aca-ra", "y-cable", "aca-rb", "aca-rc";
		#extcon-cells = <1>;
		status = "okay";
	};
};


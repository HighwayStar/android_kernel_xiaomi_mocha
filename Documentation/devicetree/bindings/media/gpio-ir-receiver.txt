## Documentation/devicetree/bindings/media/gpio-ir-receiver.txt
```
Device-Tree bindings for GPIO IR receiver

Required properties:
	- compatible: should be "gpio-ir-receiver".
	- gpios: specifies GPIO used for IR signal reception.

Optional properties:
	- linux,rc-map-name: Linux specific remote control map name.
	- allowed-protos: 64 bit integer, platform specific allowed
			  IR protocols.

Example node:

	ir: ir-receiver {
		compatible = "gpio-ir-receiver";
		gpios = <&gpio0 19 1>;
		linux,rc-map-name = "rc-rc6-mce";
		allowed-protos = <0x00000000 0x00000080>;
	};
```
